/*
 * eTechRacing.c
 *
 *  Created on: Feb 15, 2024
 *      Author: Bernat
 */
//Includes
#include "main.h"
#include "stdlib.h"
#include "eTechRacing.h"
#include "LTC6811-1_eTechRacing.h"



//Functions

/* Function: delay_us
 * Purpose: Generate a delay in microseconds
 * Inputs: The amount of microseconds of the loop, the timer which has to be used
 */
void delay_us (long int us)
{
	long int delay = us * (HAL_RCC_GetHCLKFreq() / 840000);

	for(long int i = 0; i < delay; i += 18){
		__ASM("NOP");
	}
}

uint16_t Min_Volt(uint16_t *voltatjes){
	uint16_t minimum_volt = 40000;
	for(int i = 0; i < TOTAL_IC; i++){
		for(int j = 0; j < 12; j++){
			if((((j!=5) && (j!=11)) && ((i==0) ||(i==2) ||(i==3) ||(i==5) ||(i==6) ||(i==8) ||(i==9) ||(i==11) ||(i==12) ||(i==14))) || (((j!=4) && (j!=5) && (j!=10) && (j!=11)) && ((i==1) ||(i==4) ||(i==7) ||(i==10) ||(i==13)))){
				if((voltatjes[12*i+j] <= minimum_volt)){
					minimum_volt = voltatjes[12*i+j];
				}
			}
		}
	  }
	return minimum_volt;
}


uint16_t Max_Volt(uint16_t *voltatjes){
	uint16_t maximum_volt = 0;
	for(int i = 0; i < TOTAL_IC; i++){
		for(int j = 0; j < 12; j++){
			if((((j!=5) && (j!=11)) && ((i==0) ||(i==2) ||(i==3) ||(i==5) ||(i==6) ||(i==8) ||(i==9) ||(i==11) ||(i==12) ||(i==14))) || (((j!=4) && (j!=5) && (j!=10) && (j!=11)) && ((i==1) ||(i==4) ||(i==7) ||(i==10) ||(i==13)))){
				if((voltatjes[12*i+j] >= maximum_volt)){
					maximum_volt = voltatjes[12*i+j];
				}
			}
		}
	  }
	return maximum_volt;
}

float Mean_Volt(uint16_t *voltatjes){
	float mean_volt = 0;
	uint8_t volt_length = 12*TOTAL_IC;
	for(int i = 0; i<volt_length; i++){
		mean_volt = mean_volt + voltatjes[i];
		}
	mean_volt = mean_volt/volt_length;
	return mean_volt;
	}

uint32_t Sum_Volt(uint16_t *voltatjes){
	uint32_t sum_volt = 0;
		uint8_t volt_length = 12*TOTAL_IC;
		for(int i = 0; i<volt_length; i++){
			sum_volt = sum_volt + voltatjes[i];
		}
		return sum_volt;
}

uint16_t Min_Temp(uint16_t *temperatures){
	uint16_t minimum_temp = temperatures[0];
	uint8_t temp_length = 8*TOTAL_IC;
	for(int i = 0; i<temp_length; i++){
		if(temperatures[i] <= minimum_temp){
			minimum_temp = temperatures[i];
		}
	}
	return minimum_temp;
}

uint16_t Max_Temp(uint16_t *temperatures){
	uint16_t maximum_temp = 0;
	uint8_t temp_length = 8*TOTAL_IC;
	for(int i = 0; i<temp_length; i++){
		if(temperatures[i] >= maximum_temp){
			maximum_temp = temperatures[i];
		}
	}
	return maximum_temp;
}

float Mean_Temp(uint16_t *temperatures){
	uint16_t mean_temp = 0;
	uint8_t temp_length = 8*TOTAL_IC;
	for(int i = 0; i<temp_length; i++){
		mean_temp = mean_temp + temperatures[i];
		}
	mean_temp = mean_temp/temp_length;
	return mean_temp;
	}



void Conv_Temp(uint16_t *temperatures, uint16_t *temperatures_conv){
	const uint16_t Temp_table[901]={0,1,2,3,4,5,6,7,8,9,10,11,12,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899,900};
	const uint16_t Lec[901]={22950, 22923, 22895, 22868, 22840, 22812, 22784, 22757, 22729, 22701, 22673, 22645, 22617,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 2523, 2516};

	   for(int a=0;a<8*TOTAL_IC;a++){
	   	      	int i = 0;
	   			while (i < 900 && temperatures[a] < Lec[i + 1]) {
	   				i++;
	   			}
	   			temperatures_conv[a]=Temp_table[i];
	   			if(temperatures_conv[a] == 866){
	   				temperatures_conv[a] = 0;
	   			}
	   	}
}
int32_t Curr_EVAL(uint8_t *current_arr) {
    int32_t current;
    current = (current_arr[3] + (current_arr[2] << 8)+ (current_arr[1] << 16)+ ((current_arr[0]^0X80)<< 24));
    return current;
}


